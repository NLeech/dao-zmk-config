/ {
    macros {
        zez: zez {
            label = "Zez";
            compatible = "zmk,behavior-macro";
            #binding-cells = <0>;
            bindings
                = <&macro_press &kp LSHFT>
                , <&macro_tap &kp Y >
                , <&macro_release &kp LSHFT>
                , <&macro_tap &kp T &kp G &kp H &kp J &kp C &kp N &kp J &kp K &kp J &kp C &kp M &kp N2 &kp N3 &kp N2 &kp N7>
                ;
        };
        common_sequence: common_sequence {
            label = "Common_sequence";
            compatible = "zmk,behavior-macro";
            #binding-cells = <0>;
            bindings
                = <&macro_tap &kp Y &kp T &kp G &kp H &kp J &kp C &kp N &kp J &kp K &kp J &kp C &kp M>
                ;
        };
    };
};                                            